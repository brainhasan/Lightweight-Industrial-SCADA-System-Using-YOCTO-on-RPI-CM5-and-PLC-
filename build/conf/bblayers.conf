## build/conf/bblayers.conf
```bitbake
# POKY_BBLAYERS_CONF_VERSION is increased each time build/conf/bblayers.conf
# changes incompatibly
POKY_BBLAYERS_CONF_VERSION = "2"

BBPATH = "${TOPDIR}"
BBFILES ?= ""

BBLAYERS ?= " \
  /home/hasan/workspace/SCADA-YOCTO-RPI/poky/meta \
  /home/hasan/workspace/SCADA-YOCTO-RPI/poky/meta-poky \
  /home/hasan/workspace/SCADA-YOCTO-RPI/poky/meta-yocto-bsp \
  /home/hasan/workspace/SCADA-YOCTO-RPI/meta-raspberrypi \
  /home/hasan/workspace/SCADA-YOCTO-RPI/meta-openembedded/meta-oe \
  /home/hasan/workspace/SCADA-YOCTO-RPI/meta-openembedded/meta-python \
  /home/hasan/workspace/SCADA-YOCTO-RPI/meta-openembedded/meta-networking \
  /home/hasan/workspace/SCADA-YOCTO-RPI/meta-openembedded/meta-multimedia \
  "
```

## meta-custom/conf/layer.conf
```bitbake
BBPATH .= ":${LAYERDIR}"
BBFILES += "${LAYERDIR}/recipes-core/*/*.bb ${LAYERDIR}/recipes-core/*/*.bbappend"
BBFILE_COLLECTIONS += "custom"
BBFILE_PATTERN_custom = "^${LAYERDIR}/"
BBFILE_PRIORITY_custom = "6"
LAYERSERIES_COMPAT_custom = "scarthgap kirkstone mickledore"
```

## meta-scada/conf/layer.conf
```bitbake
# We have a conf and classes directory, add to BBPATH
BBPATH .= ":${LAYERDIR}"

# We have recipes-* directories, add to BBFILES
BBFILES += "${LAYERDIR}/recipes-*/*/*.bb \
            ${LAYERDIR}/recipes-*/*/*.bbappend"

BBFILE_COLLECTIONS += "meta-scada"
BBFILE_PATTERN_meta-scada = "^${LAYERDIR}/"
BBFILE_PRIORITY_meta-scada = "6"

LAYERSERIES_COMPAT_meta-scada = "scarthgap"
```
